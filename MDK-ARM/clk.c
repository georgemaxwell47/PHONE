#include "clk.h"
#include "ssd1306.h"
#include "stdio.h"
#include "gpio.h"
#include "calender.h"
#include "stdbool.h"

#define LEDRED_ON HAL_GPIO_WritePin(GPIOA,LEDRED_Pin,GPIO_PIN_SET);
void clk_menu (int CURRENT_TIME_MIN,int CURRENT_TIME_HOUR,int CURRENT_TIME_SEC,int ALARM_ALARMHOUR,int ALARM_ALARMMIN,int ALARM_ALARMSEC,int day,int mounth ,int year){
	char BUFF [30];
			if(ALARM_ALARMHOUR == CURRENT_TIME_HOUR && ALARM_ALARMMIN == CURRENT_TIME_MIN && 0 == CURRENT_TIME_SEC){
				LEDRED_ON
			}
			if(CURRENT_TIME_MIN == 59 && CURRENT_TIME_SEC == 59 && CURRENT_TIME_HOUR == 23){
				
			}
			ssd1306_SetCursor(0,0);
			if(CURRENT_TIME_HOUR/10 == 0 && CURRENT_TIME_MIN/10 == 0)
				sprintf(BUFF,"0%d : 0%d",CURRENT_TIME_HOUR,CURRENT_TIME_MIN);
			
			else if(CURRENT_TIME_HOUR/10 != 0 && CURRENT_TIME_MIN/10 == 0)
				sprintf(BUFF,"%d : 0%d",CURRENT_TIME_HOUR,CURRENT_TIME_MIN);
			
			else if(CURRENT_TIME_HOUR/10 == 0 && CURRENT_TIME_MIN/10 != 0)
				sprintf(BUFF,"0%d : %d",CURRENT_TIME_HOUR,CURRENT_TIME_MIN);
			
			else if(CURRENT_TIME_HOUR/10 != 0 && CURRENT_TIME_MIN/10 != 0)
				sprintf(BUFF,"%d : %d",CURRENT_TIME_HOUR,CURRENT_TIME_MIN);
			
			ssd1306_WriteString(BUFF,Font_6x8,White);
}
void clk_preveiw (int CURRENT_TIME_MIN,int CURRENT_TIME_HOUR,int CURRENT_TIME_SEC,int ALARM_ALARMHOUR,int ALARM_ALARMMIN,int ALARM_ALARMSEC,int day,int mounth ,int year){
	char BUFF [30];

	if(ALARM_ALARMHOUR == CURRENT_TIME_HOUR && ALARM_ALARMMIN == CURRENT_TIME_MIN && 0 == CURRENT_TIME_SEC){
				LEDRED_ON
			}

			ssd1306_SetCursor(26,20);
			if(CURRENT_TIME_HOUR/10 == 0 && CURRENT_TIME_MIN/10 == 0)
				sprintf(BUFF,"0%d : 0%d",CURRENT_TIME_HOUR,CURRENT_TIME_MIN);
			
			else if(CURRENT_TIME_HOUR/10 != 0 && CURRENT_TIME_MIN/10 == 0)
				sprintf(BUFF,"%d : 0%d",CURRENT_TIME_HOUR,CURRENT_TIME_MIN);
			
			else if(CURRENT_TIME_HOUR/10 == 0 && CURRENT_TIME_MIN/10 != 0)
				sprintf(BUFF,"0%d : %d",CURRENT_TIME_HOUR,CURRENT_TIME_MIN);
			
			else if(CURRENT_TIME_HOUR/10 != 0 && CURRENT_TIME_MIN/10 != 0)
				sprintf(BUFF,"%d : %d",CURRENT_TIME_HOUR,CURRENT_TIME_MIN);
			
			ssd1306_WriteString(BUFF,Font_11x18,White);

}
void clk_TIM (int CURRENT_TIME_MIN,int CURRENT_TIME_HOUR,int CURRENT_TIME_SEC){
			char BUFF [30];
			ssd1306_SetCursor(0,20);
			if(CURRENT_TIME_HOUR/10 == 0 && CURRENT_TIME_MIN/10 == 0 && CURRENT_TIME_SEC/10 ==0)
				sprintf(BUFF,"0%d : 0%d : 0%d",CURRENT_TIME_HOUR,CURRENT_TIME_MIN,CURRENT_TIME_SEC);
			
			else if(CURRENT_TIME_HOUR/10 != 0 && CURRENT_TIME_MIN/10 == 0 && CURRENT_TIME_SEC/10 ==0)
				sprintf(BUFF,"%d : 0%d : 0%d",CURRENT_TIME_HOUR,CURRENT_TIME_MIN,CURRENT_TIME_SEC);
			
			else if(CURRENT_TIME_HOUR/10 == 0 && CURRENT_TIME_MIN/10 != 0 && CURRENT_TIME_SEC/10 ==0)
				sprintf(BUFF,"0%d : %d : 0%d",CURRENT_TIME_HOUR,CURRENT_TIME_MIN,CURRENT_TIME_SEC);
			
			else if(CURRENT_TIME_HOUR/10 != 0 && CURRENT_TIME_MIN/10 != 0 && CURRENT_TIME_SEC/10 ==0)
				sprintf(BUFF,"%d : %d : 0%d",CURRENT_TIME_HOUR,CURRENT_TIME_MIN,CURRENT_TIME_SEC);
			
			else if(CURRENT_TIME_HOUR/10 == 0 && CURRENT_TIME_MIN/10 == 0 && CURRENT_TIME_SEC/10 !=0)
				sprintf(BUFF,"0%d : 0%d : %d",CURRENT_TIME_HOUR,CURRENT_TIME_MIN,CURRENT_TIME_SEC);
			
			else if(CURRENT_TIME_HOUR/10 != 0 && CURRENT_TIME_MIN/10 == 0 && CURRENT_TIME_SEC/10 !=0)
				sprintf(BUFF,"%d : 0%d : %d",CURRENT_TIME_HOUR,CURRENT_TIME_MIN,CURRENT_TIME_SEC);
			
			else if(CURRENT_TIME_HOUR/10 == 0 && CURRENT_TIME_MIN/10 != 0 && CURRENT_TIME_SEC/10 !=0)
				sprintf(BUFF,"0%d : %d : %d",CURRENT_TIME_HOUR,CURRENT_TIME_MIN,CURRENT_TIME_SEC);
			
			else if(CURRENT_TIME_HOUR/10 != 0 && CURRENT_TIME_MIN/10 != 0 && CURRENT_TIME_SEC/10 !=0)
				sprintf(BUFF,"%d : %d : %d",CURRENT_TIME_HOUR,CURRENT_TIME_MIN,CURRENT_TIME_SEC);
			ssd1306_WriteString(BUFF,Font_6x8,White);
}

void clk_edit (int CURRENT_TIME_MIN,int CURRENT_TIME_HOUR,int CURRENT_TIME_SEC){
	char BUFF [30];
	
			ssd1306_SetCursor(0,30);
if(CURRENT_TIME_HOUR/10 == 0 && CURRENT_TIME_MIN/10 == 0 && CURRENT_TIME_SEC/10 ==0)
				sprintf(BUFF,"0%d : 0%d : 0%d",CURRENT_TIME_HOUR,CURRENT_TIME_MIN,CURRENT_TIME_SEC);
			
			else if(CURRENT_TIME_HOUR/10 != 0 && CURRENT_TIME_MIN/10 == 0 && CURRENT_TIME_SEC/10 ==0)
				sprintf(BUFF,"%d : 0%d : 0%d",CURRENT_TIME_HOUR,CURRENT_TIME_MIN,CURRENT_TIME_SEC);
			
			else if(CURRENT_TIME_HOUR/10 == 0 && CURRENT_TIME_MIN/10 != 0 && CURRENT_TIME_SEC/10 ==0)
				sprintf(BUFF,"0%d : %d : 0%d",CURRENT_TIME_HOUR,CURRENT_TIME_MIN,CURRENT_TIME_SEC);
			
			else if(CURRENT_TIME_HOUR/10 != 0 && CURRENT_TIME_MIN/10 != 0 && CURRENT_TIME_SEC/10 ==0)
				sprintf(BUFF,"%d : %d : 0%d",CURRENT_TIME_HOUR,CURRENT_TIME_MIN,CURRENT_TIME_SEC);
			
			else if(CURRENT_TIME_HOUR/10 == 0 && CURRENT_TIME_MIN/10 == 0 && CURRENT_TIME_SEC/10 !=0)
				sprintf(BUFF,"0%d : 0%d : %d",CURRENT_TIME_HOUR,CURRENT_TIME_MIN,CURRENT_TIME_SEC);
			
			else if(CURRENT_TIME_HOUR/10 != 0 && CURRENT_TIME_MIN/10 == 0 && CURRENT_TIME_SEC/10 !=0)
				sprintf(BUFF,"%d : 0%d : %d",CURRENT_TIME_HOUR,CURRENT_TIME_MIN,CURRENT_TIME_SEC);
			
			else if(CURRENT_TIME_HOUR/10 == 0 && CURRENT_TIME_MIN/10 != 0 && CURRENT_TIME_SEC/10 !=0)
				sprintf(BUFF,"0%d : %d : %d",CURRENT_TIME_HOUR,CURRENT_TIME_MIN,CURRENT_TIME_SEC);
			
			else if(CURRENT_TIME_HOUR/10 != 0 && CURRENT_TIME_MIN/10 != 0 && CURRENT_TIME_SEC/10 !=0)
				sprintf(BUFF,"%d : %d : %d",CURRENT_TIME_HOUR,CURRENT_TIME_MIN,CURRENT_TIME_SEC);
			ssd1306_WriteString(BUFF,Font_6x8,White);
}
